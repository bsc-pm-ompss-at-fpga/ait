/ {
  fragment@2 {
    target = <&amba>;
    overlay2: __overlay__ {
      ompss_at_fpga: ompss_at_fpga@0 {
        compatible = "ompss-at-fpga";
        bitstreaminfo = <&bitInfo_BRAM_Ctrl>;
      };
    };
  };
};
